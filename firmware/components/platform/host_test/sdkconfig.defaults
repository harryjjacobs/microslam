## firmware/components/platform/host_test/sdkconfig.defaults
```kconfig
CONFIG_UNITY_ENABLE_IDF_TEST_RUNNER=y
CONFIG_IDF_TARGET=linux
CONFIG_LOG_DEFAULT_LEVEL_NONE=y
```

## firmware/sdkconfig.defaults
```kconfig
CONFIG_IDF_TARGET="esp32s3"
CONFIG_ESP_MAIN_TASK_STACK_SIZE=5584
CONFIG_COMPILER_STACK_CHECK_MODE_NORM=y
CONFIG_ESP_CONSOLE_USB_SERIAL_JTAG=y
CONFIG_ESP_CONSOLE_SECONDARY_NONE=y
CONFIG_ESP_CONSOLE_USB_SERIAL_JTAG_ENABLED=y
CONFIG_ESP_CONSOLE_UART_NUM=-1
```
